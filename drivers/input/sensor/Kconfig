## drivers/input/sensor/Kconfig
```kconfig
#
# sensor driver configuration
#
menuconfig INPUT_SENSOR
	bool "Sensors"
	help
	  Say Y here, and a list of supported sensor will be displayed.
	  This option doesn't affect the kernel.

	  If unsure, say Y.

if INPUT_SENSOR
config SENSORS_BMA250
        tristate "BMA250 acceleration sensor support"
        select I2C
        depends on INPUT_SENSOR
        default m
        help
          If you say yes here you get support for Bosch Sensortec's
          acceleration sensors BMA250.

config SENSORS_SC7A30
        tristate "SC7A30 3-Axis Orientation/Motion Detection Sensor Support"
        select I2C
        depends on INPUT_SENSOR
        default m
        help
          If you say yes here you get support for the Freescale 3-Axis
          Orientation/Motion Detection Sensor.

config SENSORS_MMA7660
        tristate "MMA7660 3-Axis Orientation/Motion Detection Sensor Support"
        select I2C
        depends on INPUT_SENSOR
        default m
        help
          If you say yes here you get support for the Freescale 3-Axis
          Orientation/Motion Detection Sensor.

config SENSORS_MIR3DA
        tristate "MIR3DA 2-Axis Orientation/Motion Detection Sensor Support"
	select I2C
	depends on INPUT_SENSOR
	default m
	help
	 If you say yes here you get support for the Freescale 3-Axis
	 Orientation/Motion Detection Sensor.

config SENSORS_KX122
	tristate "KX122  3-Axis Orientation/Motion Detection Sensor Support "
	depends on I2C
	help
	  Say Y here if you have an KX122 I2C gsensor
	  connected to your system.

	  If unsure, say N.

config SENSORS_P15USB30216C
	tristate "Plug-In detector for TYPE-C connector"
	depends on I2C
	help
	  Say Y here if you have an P15USB30216C
	  connected to your system.

	  If unsure, say N.


config SENSORS_MXC622X
        tristate "MXC622X 2-Axis Orientation/Motion Detection Sensor Support"
        select I2C
        depends on INPUT_SENSOR
        default m
        help
          If you say yes here you get support for the MXC622X 2-Axis
          Orientation/Motion Detection Sensor.

config SENSORS_MMA8452
        tristate "MMA8452 3-Axis Orientation/Motion Detection Sensor Support"
        select I2C
        depends on INPUT_SENSOR
        default m
        help
          If you say yes here you get support for the Freescale 3-Axis
          Orientation/Motion Detection Sensor.

config SENSORS_MMA865X
        tristate "MMA865X 3-Axis Orientation/Motion Detection Sensor Support"
        select I2C
        depends on INPUT_SENSOR
        default m
        help
          If you say yes here you get support for the Freescale 3-Axis
          Orientation/Motion Detection Sensor.			  

config SENSORS_MC32X0
        tristate "MC32X0 Orientation/Motion Detection Sensor Support"
	select I2C
	depends on INPUT_SENSOR
	default m
	help
	 If you say yes here you get support for the Freescale 3-Axis
	 Orientation/Motion Detection Sensor.

config SENSORS_SC7660
        tristate "SC7660 Orientation/Motion Detection Sensor Support"
	select I2C
	depends on INPUT_SENSOR
	default n
	help
	 If you say yes here you get support for the Freescale 3-Axis
	 Orientation/Motion Detection Sensor.

config SENSORS_GPADC
        tristate "SUNXI GPADC"
        depends on INPUT_SENSOR
        default n
        help
          If you say yes here you get support for the gpadc collect analog input

config SENSORS_TPADC
        tristate "SUNXI TPADC"
        depends on INPUT_SENSOR && ARCH_SUN8IW11P1
        default n
        help
          If you say yes here you get support for the tpadc collect analog input

config SENSORS_GPADC_TEST
        tristate "SUNXI GPADC test"
        depends on SENSORS_GPADC
        default n
        help
          If you say yes here you get support for the gpadc test sample

config KEY_GPIO
	bool "allwinnner KEY GPIO support"
	depends on SENSORS_GPADC
	default n
	help

endif
source "drivers/input/sensor/bma253/Kconfig"
```

## drivers/video/fbdev/libeink/Kconfig
```kconfig
#
# EINK Library drivers configuration
#

menuconfig LIBEINK_SUPPORT
	bool "EINK Library for reagl and eclipse use"
	help
	  Enable this to be able to EINK Library support.

if LIBEINK_SUPPORT

config EC060KH1_LIBEINK
        tristate "EC060KH1 (CFA) libeink"
	default m
	help
	  EC060KH1 panel (CFA) libeink support
	  
config EC060KH6_LIBEINK
        tristate "EC060KH6 (BW) libeink"
	default m
	help
	  EC060KH6 panel (BW) libeink support

config ED103TH1_LIBEINK
        tristate "ED103TH1 (BW) libeink"
	default m
	help
	  ED103TH1 panel (BW) libeink support
	  
config ED070KH3_LIBEINK
        tristate "ED070KH3 (BW) libeink"
	default m
	help
	  ED070KH3 panel (BW) libeink support
	  
config ED080KH1_LIBEINK
        tristate "ED080KH1 (BW) libeink"
	default m
	help
	  ED080KH1 (BW) libeink support

config ED060KHC_LIBEINK
        tristate "ED060KHC (BW) libeink"
        default m
        help
          ED060KHC (BW) libeink support


endif # LIBEINK_SUPPORT
```
